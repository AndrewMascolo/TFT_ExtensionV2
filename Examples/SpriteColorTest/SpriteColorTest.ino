// Use IDE 1.0.6 or 1.5.x
#include <UTFT.h>
#include <TFTSprites.h>

extern uint8_t BigFont[];

UTFT    myGLCD(CTE70, 25, 26, 27, 28);
//UTouch  myTouch( 6, 5, 4, 3, 2);
TFTSprites mySprite(&myGLCD);

uint8_t Mario[256] = {
  0x0, 0x0, 0x0, 0x0, 0x0, 0xE0, 0xE0, 0xE0, 0xE0, 0xE0, 0x0, 0x0, 0x0, 0x0, 0x0, 0x0,
  0x0, 0x0, 0x0, 0x0, 0xE0, 0xE0, 0xE0, 0xE0, 0xE0, 0xE0, 0xE0, 0xE0, 0xE0, 0x0, 0x0,0x0,
  0x0, 0x0, 0x0, 0x0, 0x90, 0x90, 0x90, 0xF0, 0xF0, 0x04, 0xF0, 0x0, 0x0, 0x0, 0x0,0x0,
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  0x0, 0x0, 0x90, 0x90, 0x90, 0x90, 0x0, 0x0, 0x0, 0x0, 0x90, 0x90, 0x90, 0x90, 0x0,0x0
};

//byte ColorPallet[16] =
//{ 
//  0x0, 0x01, 0x10, 0x11, 0x05, 0x50, 0x55, 0x0A,
//  0xA0, 0xAA, 0x0E, 0xE0, 0xEE, 0x0F, 0xF0, 0xFF
//};

void setup()
{
  Serial.begin(115200);
  myGLCD.InitLCD(LANDSCAPE);
  myGLCD.clrScr();
  myGLCD.setFont(BigFont);
  myGLCD.fillScr(0x1111);

  IMG(Mario, 0, 0, 20);
//  mySprite.Cust_Color_Sprite_16(Mario, 180, 0, 10,1);
//  mySprite.Cust_Color_Sprite_16(Mario, 0, 180, 10,2);
//  mySprite.Cust_Color_Sprite_16(Mario, 180, 180, 10,3);
//  ShowPallet(400, 0, 20);
}

void loop()
{

}

void ShowPallet(int x, int y, int Ssize)
{
  for (int i = 0; i <= 0xFF; i++)
  {
    myGLCD.fch = ColorPallet[i / 16];
    myGLCD.fcl = ColorPallet[i % 16];
    myGLCD.fillRect(x + Ssize * (i % 16), y + Ssize * (i / 16), x + Ssize * (i % 16) + Ssize, y + Ssize * (i / 16) + Ssize);
  }
}

void IMG(uint8_t *image, int x, int y, int Ssize)
{
  for (int i = 0; i <= 0xFF; i++)
  {
    myGLCD.fch = ColorPallet[(image[i] >> 4)];
    myGLCD.fcl = ColorPallet[(image[i] & 0x0F)];
    if(!myGLCD.fch & !myGLCD.fcl)
      continue;
      
    myGLCD.fillRect(x + Ssize * (i % 16)+1, y + Ssize * (i / 16)+1, x + Ssize * (i % 16) + Ssize, y + Ssize * (i / 16) + Ssize);
  }
}


